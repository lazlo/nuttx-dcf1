## apps/examples/dcf1/Kconfig
```kconfig
#
# For a description of the syntax of this configuration file,
# see misc/tools/kconfig-language.txt.
#

config EXAMPLES_DCF1
	bool "DCF1 example"
	default n
	---help---
		Enable the DCF1 example

if EXAMPLES_DCF1

config EXAMPLES_DCF1_PROGNAME
	string "Program name"
	default "DCF1"
	depends on BUILD_KERNEL
	---help---
		This is the name of the program that will be use when the NSH ELF
		program is installed.

endif
```

## apps/examples/lsof/Kconfig
```kconfig
#
# For a description of the syntax of this configuration file,
# see misc/tools/kconfig-language.txt.
#

config EXAMPLES_LSOF
	bool "lsof example"
	default n
	---help---
		Enable the \"lsof\" example

if EXAMPLES_LSOF

config EXAMPLES_LSOF_PROGNAME
	string "Program name"
	default "lsof"
	depends on BUILD_KERNEL
	---help---
		This is the name of the program that will be use when the NSH ELF
		program is installed.

endif
```

## nuttx/drivers/radio/Kconfig
```kconfig
#
# For a description of the syntax of this configuration file,
# see misc/tools/kconfig-language.txt.
#

config RADIO_DCF1
	bool "DCF1 Time Signal Receiver"
	default n
	depends on CLOCK_MONOTONIC
	---help---
		Enable support for the DCF1 time signal receiver module.
if RADIO_DCF1

config DEBUG_DCF1_MEASUREMENT
	bool "Enable debug output for measurement stage"
	default n
	---help---
		Display measured time between level transitions on DATA pin.

config DEBUG_DCF1_DECODE
	bool "Enable debug output for decoding stage"
	default n
	---help---
		Display the calculation of bits from time delta

config DEBUG_DCF1_RECEIVE
	bool "Enable debug output for reception stage"
	default n
	---help---
		Display contents of receive buffer

config DEBUG_DCF1_SYNC
	bool "Enable debug output for synchronization stage"
	default n
	---help---
		Display synchonization process information

endif
```
